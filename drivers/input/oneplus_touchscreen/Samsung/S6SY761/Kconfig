## drivers/input/oneplus_touchscreen/Samsung/S6SY761/Kconfig
```kconfig
config TOUCHPANEL_SAMSUNG_S6SY761
#	default y
	bool "TP Samsung s6sy761 IC enable or not for OPPO"
	---help---
	say Y to enable driver for Touchpanel using Samsung s6sy761
```

## drivers/input/oplus_fp_drivers/Kconfig
```kconfig
menuconfig OPLUS_FINGERPRINT
	bool "OPLUS fingerprint"
	depends on SPI_MASTER
	help
	  Say Y here to enable OPLUS fingerprint support

config OPLUS_FINGERPRINT_GKI_DISABLE
       default n
       tristate "Fingerprint enable gki"

if OPLUS_FINGERPRINT
### fingerprint sensor config
config OPLUS_FINGERPRINT_GOODIX
       default n
       tristate "Fingerprint base on goodix capacitive chip"
config OPLUS_FINGERPRINT_GOODIX_OPTICAL
       default n
       tristate "Fingerprint base on goodix optical chip"
endif #OPLUS_FINGERPRINT
```

## drivers/oneplus/Kconfig
```kconfig
config OEM_BOOT_MODE
	bool "detect oem boot mode"
	default y
	help
          detect oem boot mode  If unsure, say y.

source "drivers/oneplus/coretech/Kconfig"
source "drivers/oneplus/oneplus_healthinfo/Kconfig"
source "drivers/oneplus/op_freezer/Kconfig"
```

## drivers/soc/oplus/Kconfig
```kconfig
config OPLUS_COMMON_SOFT
	bool "config oplus common software"
	help
	  define this config to get project verion from sharemem.
	  Maybe this value is from CDT or dynamic identify by hardware
	  id.

source "drivers/soc/oplus/device_info/Kconfig"
source "drivers/soc/oplus/sensor/Kconfig"
source "drivers/soc/oplus/system/Kconfig"
source "drivers/soc/oplus/thermal/Kconfig"
```

## drivers/soc/oplus/device_info/Kconfig
```kconfig
config OPLUS_DEVICE_IFNO
	bool "config oplus devinfo"
	help
	  define this config to compile devinfo.c for device register
```

## drivers/soc/oplus/oplus_healthinfo/Kconfig
```kconfig
#ifdef OPLUS_FEATURE_HEALTHINFO
config OPLUS_HEALTHINFO
bool "config oplus healthinfo"
help
    define this config to init oplus healthinfo.
config CAMERA_OPT
	bool "config camera opt"
	default n
	help
	  reduce camera provider task runnable time
config MMAP_LOCK_OPT
	bool "config mmap lock opt boos"
	default n
	help
	  reduce sleep time in mmap lock
#endif /* OPLUS_FEATURE_HEALTHINFO */
```

## drivers/soc/oplus/system/Kconfig
```kconfig
# SPDX-License-Identifier: GPL-2.0-only
# Copyright (C) 2018-2020 Oplus. All rights reserved.
config OPLUS_SYSTEM_KERNEL
	bool "config oplus system feature"
	help
	  define this config to add oplus sytstem kernel feature

config OPLUS_COMMON_SOFT
	bool "config oplus common software"
	help
	  define this config to get project verion from sharemem.
	  Maybe this value is from CDT or dynamic identify by hardware
	  id.

config OPLUS_FEATURE_DETAILHEAD
	tristate "config detail kmsg"
	help
	  define this config to add cpu number and current id and current comm to kmsg

source "drivers/soc/oplus/system/oplus_project/Kconfig"
source "drivers/soc/oplus/system/project_info/Kconfig"
source "drivers/soc/oplus/system/qcom_pmicwd/Kconfig"
```

## drivers/soc/oplus/system/oplus_project/Kconfig
```kconfig
#
#oplus project info configuration
#
config OPLUS_FEATURE_OPROJECT
	tristate "config oplus project info for kernel"
	default n
	help
	  define this config to define oplus project
```

## drivers/soc/oplus/system/project_info/Kconfig
```kconfig
config OPLUS_FEATURE_PROJECTINFO
	tristate "config oplus common software"
	default n
	help
	  define this config to get project verion from sharemem.
	  Maybe this value is from CDT or dynamic identify by hardware
	  id.
```

## drivers/soc/oplus/system/selinux/Kconfig
```kconfig
config OPLUS_FEATURE_SELINUX_CONTROL_LOG
  bool "config control selinux log"
  default y
  help
	define this config to control selinux log.
```

## drivers/soc/oplus/thermal/Kconfig
```kconfig
#
# Generic thermal sysfs drivers configuration
#

config HORAE_THERMAL_SHELL
	  tristate "Horae shell temp driver"
	  default y
	  help
	    Provide three thermal zones(front, frame and back) to get real shell temp.

#ifdef OPLUS_FEATURE_DRG
source "drivers/soc/oplus/thermal/oplus_drg/Kconfig"
#endif /* OPLUS_FEATURE_DRG */

#ifdef OPLUS_FEATURE_GKI_CPUFREQ_BOUNCING
source "drivers/soc/oplus/thermal/cpufreq_bouncing/Kconfig"
#endif /* OPLUS_FEATURE_GKI_CPUFREQ_BOUNCING */
```

## drivers/vm_fragment_monitor/Kconfig
```kconfig
config VM_FRAGMENT_MONITOR
    bool "monitor virtual memory fragment"
    default n
```

## fs/proc/oplus_healthinfo/Kconfig
```kconfig
#ifdef VENDOR_EDIT
config FG_TASK_UID
	bool "Enable /proc/fg_info/ if EXPERT"
	default y
	help
	  Add foreground process optimize support to promote performance .
#endif /*VENDOR_EDIT*/
#ifdef VENDOR_EDIT
config OPLUS_JANK_INFO
	bool "Enable /proc/pid/jank_info if EXPERT"
	default n
	help
	  Add jank monitor opt support .
#endif /*VENDOR_EDIT*/
```

## init/Kconfig.gki
```kconfig
config GKI_HIDDEN_GPU_CONFIGS
	bool "Hidden GPU configuration needed for GKI"
	select TRACE_GPU_MEM
	help
	  Dummy config option used to enable the hidden GPU config.
	  These are normally selected implicitly when a module
	  that relies on it is configured.

# Atrocities needed for
# a) building GKI modules in separate tree, or
# b) building drivers that are not modularizable
#
# All of these should be reworked into an upstream solution
# if possible.
#
config GKI_HACKS_TO_FIX
	bool "GKI Dummy config options"
	select GKI_HIDDEN_GPU_CONFIGS
	help
	  Dummy config option used to enable core functionality used by
	  modules that may not be selectable in this config.

	  Unless you are building a GKI kernel to be used with modules
	  built from a different config, say N here.
```
